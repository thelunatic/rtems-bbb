/dts-v1/;
/plugin/;
 
/ {

    compatible = "ti,am335x-bone-black", "ti,am335x-bone", "ti,am33xx";
     
    fragment@0 {
        target = <&i2c0>;
        __overlay__ {
            compatible = "rtems,bsp-i2c", "ti,omap4-i2c";
            status = "okay";
            rtems,i2c-path= "/dev/i2c-0";
            
        };

    };
};
